## layers/meta-resin-var-som-mx6/conf/layer.conf
```bitbake
BBPATH .= ":${LAYERDIR}"

BBFILES += "${LAYERDIR}/recipes-*/*/*.bb \
            ${LAYERDIR}/recipes-*/*/*.bbappend"

BBFILE_COLLECTIONS += "resin-var-som-mx6"
BBFILE_PATTERN_resin-var-som-mx6 := "^${LAYERDIR}/"
BBFILE_PRIORITY_resin-var-som-mx6 = "5"

# Mask bbappends which we do not use
# (not masking them  will require us to also add the git://github.com/Freescale/meta-fsl-demos submodule)
BBMASK ?= ".*/meta-variscite-fslc/recipes-qt5/qt5/"
BBMASK .= "|.*/meta-variscite-fslc/recipes-fsl/fsl-rc-local/"
BBMASK .= "|.*/meta-variscite-fslc/recipes-browser/"
BBMASK .= "|.*/meta-variscite-fslc/recipes-support/swupdate/"
BBMASK .= "|.*/meta-variscite-fslc/recipes-fsl/packagegroup/packagegroup-qt5-toolchain-target.bbappend"
BBMASK .= "|.*/meta-variscite-fslc/recipes-fsl/packagegroup/packagegroup-fsl-tools-testapps.bbappend"
BBMASK .= "|.*/meta-variscite-fslc/recipes-fsl/packagegroup/packagegroup-fsl-gstreamer1.0.bbappend"
BBMASK .= "|.*/meta-variscite-fslc/recipes-connectivity/wl18xx-firmware/"

IMAGE_INSTALL_remove += " fsl-rc-local"
IMAGE_INSTALL_append += " can-utils iproute2"

DISTRO_FEATURES_append += " bluez5 bluetooth wifi"
```
